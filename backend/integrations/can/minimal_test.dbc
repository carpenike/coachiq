VERSION ""

NS_ :

BS_:

BU_: TestNode

BO_ 100 TestMessage: 8 TestNode
 SG_ TestSignal : 0|8@1+ (1,0) [0|255] "" TestNode
