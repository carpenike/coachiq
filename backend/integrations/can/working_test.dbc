VERSION ""

NS_ :

BS_:

BU_: ECU TestNode

BO_ 256 TestMessage: 8 ECU
 SG_ TestSignal : 0|8@1+ (1,0) [0|255] "" ECU

BO_ 512 RVCMessage: 8 TestNode
 SG_ RVCSignal : 0|16@1+ (0.1,0) [0|6553.5] "V" TestNode
