VERSION ""

NS_ :

BS_:

BU_ ECU

BO_ 256 TestMessage: 8 ECU
 SG_ TestSignal : 0|8@1+ (1,0) [0|255] "" ECU
